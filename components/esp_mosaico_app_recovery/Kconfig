## components/esp_mosaico_app_recovery/Kconfig
```kconfig
menu "ESP-Mosaico application recovery"

config ESP_MOSAICO_APP_SYSTEM_INVENTORY
    bool
    default y
    select ESP_IRIS_SYSTEM_INVENTORY
    help
        Keep the read-only ESP-Iris System Inventory enabled in every normal
        application so a Recovery System Update can be verified after reboot.

config ESP_MOSAICO_APP_AUTO_ACCEPT
    bool "Automatically accept a pending OTA image"
    default y
    help
        Mark the installed application healthy after ESP-Iris starts. Disable
        this only when intentionally testing bootloader rollback.

config ESP_MOSAICO_APP_ACCEPT_DELAY_MS
    int "Automatic acceptance delay (milliseconds)"
    range 1000 30000
    default 3000
    depends on ESP_MOSAICO_APP_AUTO_ACCEPT

endmenu
```

## get-started/main/Kconfig.projbuild
```kconfig
menu "Get Started OTA"

config GET_STARTED_RECOVERY
    bool "Build the retained factory recovery image"
    default n
    select ESP_IRIS_OTA
    help
        Build the image installed in the factory partition. It remains outside
        the single normal OTA slot and writes updates while running from factory.

config GET_STARTED_AUTO_ACCEPT
    bool "Automatically accept a pending OTA image"
    default y
    depends on !GET_STARTED_RECOVERY
    help
        Mark an OTA image healthy after ESP-Iris starts. Disable this when
        intentionally testing bootloader rollback.

config GET_STARTED_ACCEPT_DELAY_MS
    int "Automatic acceptance delay (milliseconds)"
    range 1000 30000
    default 3000
    depends on GET_STARTED_AUTO_ACCEPT && !GET_STARTED_RECOVERY

endmenu
```

## projects/factory/bootloader_components/main/Kconfig
```kconfig
menu "Factory recovery boot"

    config FACTORY_RECOVERY_BOOT_GPIO
        int "GPIO used to request factory recovery"
        range 0 61 if IDF_TARGET_ESP32S31
        default 7
        help
            The bootloader configures this pin as an input with its internal
            pull-up enabled. Holding it low during reset selects the factory
            recovery image for this boot only.

    config FACTORY_RECOVERY_BOOT_DEBOUNCE_MS
        int "Low-level debounce time (milliseconds)"
        range 0 1000
        default 50
        help
            The pin must remain low for this duration. A released pin adds no
            debounce delay to normal startup.

endmenu
```

## projects/factory/main/Kconfig.projbuild
```kconfig
menu "Iris Factory Recovery"

config FACTORY_RECOVERY_FIRMWARE
    bool
    default y
    select ESP_IRIS_OTA
    help
        Identify this project as the retained Recovery firmware and enable the
        Recovery-only ESP-Iris OTA writer.

config IRIS_FACTORY_WIFI_MAX_NETWORKS
    int "Maximum Wi-Fi scan results shown"
    range 4 16
    default 8

config IRIS_FACTORY_WIFI_CONNECT_TIMEOUT_MS
    int "Wi-Fi connection timeout (milliseconds)"
    range 5000 60000
    default 15000

config IRIS_FACTORY_MDNS_PREFIX
    string "mDNS hostname prefix"
    default "mosaico"

config IRIS_FACTORY_SYSTEM_UPDATE_BACKEND
    bool "Register the unsigned full-system update Flash backend"
    default y
    depends on ESP_IRIS_SYSTEM_UPDATE && !SECURE_FLASH_ENC_ENABLED
    help
        Accept unsigned manifests and allow recovery to update ota_0, the
        bootloader and the partition table. Transport/session access control,
        manifest/component SHA-256, image validation and protected-partition
        policy still apply, but there is no release-key authentication.

        The recovery, sysmeta, OTA data, PHY data, core-dump and application
        NVS regions must retain their current offsets and sizes. ota_0 must
        retain its start address; its size may change only when the same plan
        supplies an application image that fits the target layout.

        This first product backend intentionally rejects flash-encrypted
        builds. System Inventory remains available without a writer.

config IRIS_FACTORY_HTTP_SYSTEM_UPDATE
    bool "Enable recovery HTTP(S) system-update pull"
    default n
    depends on IRIS_FACTORY_SYSTEM_UPDATE_BACKEND
    select MBEDTLS_CERTIFICATE_BUNDLE
    help
        Register RPC 0x1201/1. Its payload is a manifest.json URL. Recovery
        downloads the manifest and each root-level component file from the
        same directory, then feeds the existing product Flash-policy backend.
        The update remains unsigned until a product release key is configured.

config IRIS_FACTORY_HTTP_SYSTEM_UPDATE_ALLOW_PLAIN_HTTP
    bool "Allow unencrypted HTTP update URLs"
    default n
    depends on IRIS_FACTORY_HTTP_SYSTEM_UPDATE
    help
        Development-only option for trusted isolated networks. HTTPS with
        certificate verification remains the production default.

config IRIS_FACTORY_HTTP_SYSTEM_UPDATE_TIMEOUT_MS
    int "HTTP operation timeout (milliseconds)"
    range 1000 120000
    default 30000
    depends on IRIS_FACTORY_HTTP_SYSTEM_UPDATE

config IRIS_FACTORY_HTTP_SYSTEM_UPDATE_NETWORK_WAIT_MS
    int "Maximum wait for Wi-Fi connectivity (milliseconds)"
    range 1000 600000
    default 60000
    depends on IRIS_FACTORY_HTTP_SYSTEM_UPDATE

config IRIS_FACTORY_HTTP_SYSTEM_UPDATE_TASK_STACK
    int "HTTP system-update task stack size"
    range 6144 16384
    default 8192
    depends on IRIS_FACTORY_HTTP_SYSTEM_UPDATE

config IRIS_FACTORY_HTTP_SYSTEM_UPDATE_AUTO_START
    bool "Automatically pull the configured manifest in Recovery"
    default n
    depends on IRIS_FACTORY_HTTP_SYSTEM_UPDATE

config IRIS_FACTORY_HTTP_SYSTEM_UPDATE_MANIFEST_URL
    string "Automatic system-update manifest URL"
    default ""
    depends on IRIS_FACTORY_HTTP_SYSTEM_UPDATE_AUTO_START
    help
        Absolute URL of manifest.json. Component file names in the manifest
        are resolved relative to this URL. Leave empty to disable auto-start.

config IRIS_FACTORY_NAND_SYSTEM_UPDATE
    bool "Enable recovery NAND LittleFS system-update source"
    default n
    depends on IRIS_FACTORY_SYSTEM_UPDATE_BACKEND
    select NAND_FLASH_ENABLE_BDL
    help
        Register RPC 0x1201/2. Its payload is an absolute manifest path below
        /nand. Recovery mounts the board SPI NAND LittleFS read-write, exposes
        the complete /nand tree as the writable ESP-Iris volume "nand", and
        reads the manifest plus every root-level component from its directory.
        Mount failures never format the NAND and do not prevent Recovery USB
        maintenance from starting.
        The Recovery UI scans /nand/system-update/manifest.json and one level
        of release subdirectories so an operator can select a bundle locally.

config IRIS_FACTORY_NAND_SYSTEM_UPDATE_TASK_STACK
    int "NAND system-update task stack size"
    range 6144 16384
    default 8192
    depends on IRIS_FACTORY_NAND_SYSTEM_UPDATE

config IRIS_FACTORY_NAND_SYSTEM_UPDATE_AUTO_START
    bool "Automatically apply the configured NAND bundle in Recovery"
    default n
    depends on IRIS_FACTORY_NAND_SYSTEM_UPDATE

config IRIS_FACTORY_NAND_SYSTEM_UPDATE_MANIFEST_PATH
    string "Automatic NAND system-update manifest path"
    default "/nand/system-update/manifest.json"
    depends on IRIS_FACTORY_NAND_SYSTEM_UPDATE_AUTO_START
    help
        Absolute LittleFS path below /nand. Component file names in the
        manifest are resolved relative to this file. Leave empty to disable
        auto-start.

endmenu
```

## projects/get-started/main/Kconfig.projbuild
```kconfig
menu "Get Started OTA"

config GET_STARTED_RECOVERY
    bool "Build the retained factory recovery image"
    default n
    select ESP_IRIS_OTA
    help
        Build the image installed in the factory partition. It remains outside
        the single normal OTA slot and writes updates while running from factory.

choice GET_STARTED_RECOVERY_IMAGE_SOURCE
    prompt "Recovery image source"
    default GET_STARTED_RECOVERY_IMAGE_PREBUILT
    depends on !GET_STARTED_RECOVERY
    help
        Select the recovery image prepared alongside application and candidate
        builds. The selected image is staged under the active build directory.

config GET_STARTED_RECOVERY_IMAGE_PREBUILT
    bool "Use checked-in prebuilt recovery image"
    help
        Validate and copy the recovery image stored in prebuilt/recovery. This
        is the fast path for normal development builds.

config GET_STARTED_RECOVERY_IMAGE_BUILD
    bool "Build recovery from current source"
    help
        Build recovery in an isolated sub-build before staging it. Select this
        while changing recovery source code or configuration.

endchoice

config GET_STARTED_AUTO_ACCEPT
    bool "Automatically accept a pending OTA image"
    default y
    depends on !GET_STARTED_RECOVERY
    help
        Mark an OTA image healthy after ESP-Iris starts. Disable this when
        intentionally testing bootloader rollback.

config GET_STARTED_ACCEPT_DELAY_MS
    int "Automatic acceptance delay (milliseconds)"
    range 1000 30000
    default 3000
    depends on GET_STARTED_AUTO_ACCEPT && !GET_STARTED_RECOVERY

endmenu
```

## projects/hello_world/main/Kconfig.projbuild
```kconfig
menu "Hello World OTA"

config GET_STARTED_RECOVERY
    bool
    default n

config GET_STARTED_AUTO_ACCEPT
    bool "Automatically accept a pending OTA image"
    default y
    help
        Mark the installed image healthy after ESP-Iris starts.

config GET_STARTED_ACCEPT_DELAY_MS
    int "Automatic acceptance delay (milliseconds)"
    range 1000 30000
    default 3000
    depends on GET_STARTED_AUTO_ACCEPT

endmenu
```

## projects/hello_world/sdkconfig.defaults
```kconfig
CONFIG_IDF_TARGET="esp32s31"
CONFIG_IDF_EXPERIMENTAL_FEATURES=y
CONFIG_COMPILER_OPTIMIZATION_PERF=y

CONFIG_ESPTOOLPY_FLASHSIZE_16MB=y
CONFIG_PARTITION_TABLE_CUSTOM=y
CONFIG_PARTITION_TABLE_CUSTOM_FILENAME="partitions.csv"
CONFIG_BOOTLOADER_APP_ROLLBACK_ENABLE=y
CONFIG_FACTORY_RECOVERY_BOOT_GPIO=7
CONFIG_FACTORY_RECOVERY_BOOT_DEBOUNCE_MS=50

# USB High-Speed is owned by ESP-Iris. Device installation and logs go through
# the repository's mosaico.py commands.
CONFIG_ESP_CONSOLE_USB_SERIAL_JTAG=y
CONFIG_ESP_CONSOLE_SECONDARY_NONE=y
CONFIG_ESP_IRIS_TRANSPORT_USB=y
CONFIG_ESP_IRIS_TRANSPORT_TCP=y
CONFIG_ESP_IRIS_TRANSPORT_CLAIM_TIMEOUT_MS=2000
CONFIG_ESP_IRIS_TCP_PORT=19772
CONFIG_ESP_IRIS_TCP_PAIRING=y
CONFIG_ESP_IRIS_TASK_STACK_SIZE=3328
CONFIG_TINYUSB_CDC_RX_BUFSIZE=8192
CONFIG_TINYUSB_CDC_TX_BUFSIZE=8192
CONFIG_TINYUSB_CDC_EP_BUFSIZE=8192

# ESP-Mosaico 480x480 CO5300 QSPI display and LVGL.
CONFIG_BSP_CO5300_ENABLE_TE=y
CONFIG_LV_CONF_SKIP=y
CONFIG_LV_COLOR_DEPTH_16=y
CONFIG_LV_OS_FREERTOS=y
CONFIG_LV_DEF_REFR_PERIOD=15
CONFIG_LV_DPI_DEF=60
CONFIG_LV_USE_CLIB_MALLOC=y
CONFIG_LV_USE_CLIB_STRING=y
CONFIG_LV_USE_CLIB_SPRINTF=y
CONFIG_LV_FONT_MONTSERRAT_48=y

# Display frame buffers are allocated in PSRAM by esp_lvgl_adapter.
CONFIG_SPIRAM=y
CONFIG_SPIRAM_SPEED_250M=y
CONFIG_SPIRAM_XIP_FROM_PSRAM=y
CONFIG_SPIRAM_MEMTEST=n

CONFIG_APP_PROJECT_VER_FROM_CONFIG=y
CONFIG_APP_PROJECT_VER="1.0.0"
```

## projects/minihub_panel/components/app_hub/Kconfig.projbuild
```kconfig
menu "MiniHub panel"

config MINIHUB_PANEL_WIFI_SSID
    string "Wi-Fi SSID"
    default ""
    help
        Station network used by the Mosaico panel. When empty, the
        application tries the Wi-Fi profile already saved in NVS.

config MINIHUB_PANEL_WIFI_PASSWORD
    string "Wi-Fi password"
    default ""

config MINIHUB_PANEL_HUB_URL
    string "MiniHub base URL"
    default "http://127.0.0.1"
    help
        Embedded Host listens on this device. Leave the loopback URL
        unless the panel is talking to another Hub.

config MINIHUB_PANEL_HUB_USERNAME
    string "MiniHub username"
    default "admin"

config MINIHUB_PANEL_HUB_PASSWORD
    string "MiniHub password"
    default ""

config MINIHUB_PANEL_API_TOKEN
    string "MiniHub bearer token"
    default ""
    help
        Unused when the panel talks to the on-device Host with login auth off.

endmenu
```

## projects/mosaico_game/main/Kconfig.projbuild
```kconfig
menu "Mosaico Chess"

config MOSAICO_GAME_DEV_PVP
    bool "Enable simulated dual-device flow"
    default n
    help
        Development-only entry for native simulator and protocol-flow tests.
        Production builds keep simulated pairing hidden and use magnetic
        contact plus ESP-NOW for real dual-device sessions.

endmenu
```

## projects/mosaico_hop/shared/boards/esp-mosaico/sdkconfig.defaults
```kconfig
CONFIG_IDF_TARGET="esp32s31"
CONFIG_IDF_EXPERIMENTAL_FEATURES=y
CONFIG_SPIRAM=y
CONFIG_SPIRAM_SPEED_250M=y
CONFIG_SPIRAM_XIP_FROM_PSRAM=y
CONFIG_SPIRAM_MEMTEST=n
CONFIG_SPIRAM_USE_MALLOC=y
CONFIG_COMPILER_OPTIMIZATION_PERF=y
CONFIG_FREERTOS_HZ=1000
CONFIG_ESP_MAIN_TASK_STACK_SIZE=20480
CONFIG_ESPTOOLPY_FLASHSIZE_16MB=y
CONFIG_PARTITION_TABLE_CUSTOM=y
CONFIG_PARTITION_TABLE_CUSTOM_FILENAME="shared/boards/esp-mosaico/partitions.csv"

CONFIG_ESP_CONSOLE_UART_DEFAULT=y
# CONFIG_ESP_CONSOLE_USB_SERIAL_JTAG is not set
CONFIG_ESP_CONSOLE_SECONDARY_NONE=y
# Board Manager hardware providers (presenter continues without TE sync).
CONFIG_ESP_BOARD_PERIPH_GPIO_SUPPORT=y
CONFIG_ESP_BOARD_PERIPH_I2C_SUPPORT=y
CONFIG_ESP_BOARD_PERIPH_I2S_SUPPORT=y
CONFIG_ESP_BOARD_PERIPH_LEDC_SUPPORT=y
CONFIG_ESP_BOARD_PERIPH_SPI_SUPPORT=y
CONFIG_ESP_BOARD_DEV_AUDIO_CODEC_SUPPORT=y
CONFIG_ESP_BOARD_DEV_CUSTOM_SUPPORT=y
CONFIG_ESP_BOARD_DEV_DISPLAY_LCD_SUPPORT=y
CONFIG_ESP_BOARD_DEV_DISPLAY_LCD_SUB_SPI_SUPPORT=y
CONFIG_ESP_BOARD_DEV_LCD_TOUCH_SUPPORT=y
CONFIG_ESP_BOARD_DEV_LCD_TOUCH_SUB_I2C_SUPPORT=y
CONFIG_ESP_BOARD_DEV_LEDC_CTRL_SUPPORT=y
CONFIG_ESP_BOARD_DEV_POWER_CTRL_SUPPORT=y
CONFIG_ESP_BOARD_DEV_POWER_CTRL_SUB_GPIO_SUPPORT=y

# Keep the game main task on CPU1 across native and Iris builds.
CONFIG_ESP_MAIN_TASK_AFFINITY_CPU1=y
```

## tests/firmware/iris_crash/sdkconfig.defaults
```kconfig
CONFIG_IDF_TARGET="esp32s31"
CONFIG_IDF_EXPERIMENTAL_FEATURES=y
CONFIG_COMPILER_OPTIMIZATION_PERF=y

CONFIG_ESPTOOLPY_FLASHSIZE_16MB=y
CONFIG_PARTITION_TABLE_CUSTOM=y
CONFIG_PARTITION_TABLE_CUSTOM_FILENAME="partitions.csv"
CONFIG_ESP_IRIS_NVS_PARTITION_NAME="sysmeta"
CONFIG_BOOTLOADER_APP_ROLLBACK_ENABLE=y
CONFIG_FACTORY_RECOVERY_BOOT_GPIO=7
CONFIG_FACTORY_RECOVERY_BOOT_DEBOUNCE_MS=50

CONFIG_ESP_CONSOLE_UART_DEFAULT=y
# CONFIG_ESP_CONSOLE_USB_SERIAL_JTAG is not set
CONFIG_ESP_CONSOLE_SECONDARY_NONE=y
CONFIG_ESP_IRIS_TRANSPORT_USB=y
CONFIG_ESP_IRIS_TRANSPORT_TCP=y
CONFIG_ESP_IRIS_TRANSPORT_CLAIM_TIMEOUT_MS=2000
CONFIG_ESP_IRIS_TCP_PORT=19772
CONFIG_ESP_IRIS_TCP_PAIRING=y
CONFIG_ESP_IRIS_TASK_STACK_SIZE=3328
CONFIG_ESP_IRIS_LOG_RING_BYTES=8192
CONFIG_ESP_IRIS_LOG_RING_STORAGE_INTERNAL=y
CONFIG_TINYUSB_CDC_RX_BUFSIZE=8192
CONFIG_TINYUSB_CDC_TX_BUFSIZE=8192
CONFIG_TINYUSB_CDC_EP_BUFSIZE=8192

CONFIG_ESP_COREDUMP_ENABLE_TO_FLASH=y
CONFIG_ESP_COREDUMP_CHECK_BOOT=y
CONFIG_ESP_COREDUMP_MAX_TASKS_NUM=4
CONFIG_ESP_COREDUMP_STACK_SIZE=2048
# CONFIG_ESP_COREDUMP_CAPTURE_DRAM is not set
CONFIG_APP_RETRIEVE_LEN_ELF_SHA=64
CONFIG_ESP_IRIS_MAX_RPC_HANDLERS=12
CONFIG_ESP_TASK_WDT_EN=y
CONFIG_ESP_TASK_WDT_INIT=y
CONFIG_ESP_TASK_WDT_PANIC=y
CONFIG_ESP_TASK_WDT_TIMEOUT_S=2

CONFIG_SPIRAM=y
CONFIG_SPIRAM_SPEED_250M=y
CONFIG_SPIRAM_XIP_FROM_PSRAM=y
CONFIG_SPIRAM_MEMTEST=n

CONFIG_APP_PROJECT_VER_FROM_CONFIG=y
CONFIG_APP_PROJECT_VER="1.0.0"
```

## tests/firmware/iris_internal_budget/sdkconfig.defaults
```kconfig
CONFIG_IDF_TARGET="esp32s31"
CONFIG_HEAP_USE_HOOKS=y
CONFIG_FREERTOS_USE_TRACE_FACILITY=y
CONFIG_ESP_IRIS_TASK_MEMORY_OBSERVATION=y
CONFIG_PARTITION_TABLE_CUSTOM_FILENAME="../../../projects/hello_world/partitions.csv"
CONFIG_ESP_IRIS_USB_PRODUCT="ESP-Iris Internal Budget Test"
```
